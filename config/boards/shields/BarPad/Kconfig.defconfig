## config/boards/shields/BarPad_dongle/Kconfig.defconfig
```kconfig
if SHIELD_BARPAD_DONGLE

config ZMK_KEYBOARD_NAME
    default "BarPad Dongle"

config ZMK_SPLIT_ROLE_CENTRAL
    default y

config ZMK_SPLIT
    default y

config ZMK_SPLIT_BLE_CENTRAL_PERIPHERALS
    default 1

endif
```
